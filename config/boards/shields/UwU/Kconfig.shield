## config/boards/shields/UwU/Kconfig.shield
```kconfig
# Copyright (c) 2025 Ellie Ernst
# SPDX-License-Identifier: MIT

config SHIELD_RHYMESTONE_LEFT
	def_bool $(shields_list_contains,UwU_master)

config SHIELD_RHYMESTONE_RIGHT
	def_bool $(shields_list_contains,UwU_slave)
```

## config/boards/shields/rhymestone/Kconfig.shield
```kconfig
# Copyright (c) 2021 Caiden Block
# SPDX-License-Identifier: MIT

config SHIELD_RHYMESTONE_LEFT
	def_bool $(shields_list_contains,UwU_master)

config SHIELD_RHYMESTONE_RIGHT
	def_bool $(shields_list_contains,UwU_slave)
```
